## arch/arm/mach-rcm/Kconfig
```kconfig
if ARCH_RCM_ARM

choice
	prompt "RC-Module board select"

config TARGET_1879VM8YA
	bool "Support 1879VM8YA based boards"
	select SPL_DM_SERIAL
	select DM_SERIAL
	select SPL_DM_SPI
	select DM_SPI
	select SPI

config TARGET_1888BC048
	bool "Support 1888BC048 based boards"
	select SPL_DM_SERIAL
	select DM_SERIAL
	select SPL_DM_SPI
	select DM_SPI
	select SPI

endchoice

endif

source "board/rcm/mc127-05/Kconfig"
source "board/rcm/mt143-05/Kconfig"
```

## arch/powerpc/cpu/ppc470s/Kconfig
```kconfig
menu "ppc470s CPU"
	depends on PPC470S

config SYS_CPU
	default "ppc470s"

choice
	prompt "Target select"
	optional

config TARGET_1888TX018
	bool "Support 1888TX018"
	select SUPPORT_SPL
	select CREATE_ARCH_SYMLINK

config TARGET_1888BM18
	bool "Support 1888BM18"
	select SUPPORT_SPL
	select CREATE_ARCH_SYMLINK

endchoice

if TARGET_1888TX018

choice
	prompt "1888TX018 board select"

config TARGET_1888TX018_MALINA
	bool "malina"
	help
	  This option specifies support for the malina board.

config TARGET_1888TX018_MB115_01
	bool "MB115-01"
	help
	  This option specifies support for the MB115-01 board.

endchoice

endif

source "board/rcm/malina/Kconfig"
source "board/rcm/mb115-01/Kconfig"
source "board/rcm/mt150-02/Kconfig"

endmenu
```

## board/rcm/mb115-01/Kconfig
```kconfig
if TARGET_1888TX018_MB115_01

config SYS_BOARD
	default "mb115-01"

config SYS_VENDOR
	default "rcm"

config SYS_CONFIG_NAME
	default "1888tx018"

config SYS_TEXT_BASE
	hex "Entry point for u-boot startup"
	default 0x4D000040

config SPL_TEXT_BASE
	hex "Entry point for SPL startup"
	default 0x00040000

config PPC_DCR
    bool "Enable cotrol via DCR bus"
	default y

config SYS_DDR_BASE
	hex "Base address DDR RAM memory"
    default 0x40000000

config ENV_SPI_MAX_HZ
	int "Spi bus maximal frequency"
	depends on ENV_IS_IN_SPI_FLASH
	help
		"Spi bus maximal frequency,can be lower"
	default 12500000

config ENV_ADDR
	hex "Environment absolute address"
	help
		"Address of environment for nor flash"
	depends on ENV_IS_IN_FLASH
	default 0x21040000

config ENV_OFFSET
	hex "Environment offset"
	help
		Offset from base address where is environment of u-boot"
	depends on ENV_IS_IN_NAND || ENV_IS_IN_FLASH || ENV_IS_IN_SPI_FLASH || ENV_IS_IN_MMC
	default 0x40000 if ENV_IS_IN_NAND
	default 0x1040000 if ENV_IS_IN_FLASH
	default 0x140000 if ENV_IS_IN_SPI_FLASH
	default 0xF0000 if ENV_IS_IN_MMC

config ENV_SIZE
	hex "Environment size"
	help
		"Size of enviroment of u-boot"
	default 0x4000

config ENV_SECT_SIZE
	hex "Environment sector size"
	help
		"Size of sector of memory devices,where are storing data"
	depends on ENV_IS_IN_NAND || ENV_IS_IN_FLASH || ENV_IS_IN_SPI_FLASH
	default 0x20000 if ENV_IS_IN_NAND
	default 0x40000 if ENV_IS_IN_FLASH
	default 0x10000 if ENV_IS_IN_SPI_FLASH

config PPC32
	bool "Use in version>2020.04 for usb driver"
	default y

choice
	prompt "First device for the bootloader image from SPL"

config TARGET_1888TX018_MB115_01_SPL_FIRST_DEVICE_MMC
	bool "SD/MMC"
	depends on MMC

config TARGET_1888TX018_MB115_01_SPL_FIRST_DEVICE_SPI_FLASH
	bool "SPI-flash"
	depends on SPI_FLASH

config TARGET_1888TX018_MB115_01_SPL_FIRST_DEVICE_NOR
	bool "NOR"
	depends on MTD_RCM_NOR

config TARGET_1888TX018_MB115_01_SPL_FIRST_DEVICE_UART_EDCL
	bool "UART/EDCL"

endchoice

endif
```

## board/rcm/mt143-05/Kconfig
```kconfig
if TARGET_1888BC048

config BIVK_BC048
	bool "Support BIVK"
	default n

config SYS_BOARD
	default "mt143-05"

config SYS_VENDOR
	default "rcm"

config SYS_CONFIG_NAME
	default "1888bc048"

config SPL_TEXT_BASE
	default 0x00040000

config SYS_TEXT_BASE
	default 0x80000040


config ENV_OFFSET
	hex "Environment offset"
	help
		Offset from base address where is environment of u-boot"
	depends on ENV_IS_IN_SPI_FLASH || ENV_IS_IN_MMC || ENV_IS_IN_EEPROM
	default 0x40000 if ENV_IS_IN_SPI_FLASH
	default 0xF0000 if ENV_IS_IN_MMC
	default 0x0 if ENV_IS_IN_EEPROM

config ENV_SIZE
	hex "Environment size"
	help
		"Size of enviroment of u-boot"
	default 0x4000

config ENV_SECT_SIZE
	hex "Environment sector size"
	help
		"Size of sector of memory devices,where are storing data"
	depends on ENV_IS_IN_SPI_FLASH
	default 0x10000 if ENV_IS_IN_SPI_FLASH

endif
```

## configs/malina_defconfig
```kconfig
CONFIG_PPC=y
CONFIG_SPL_LDSCRIPT="arch/powerpc/cpu/ppc470s/u-boot-spl.lds"
CONFIG_SPL_GPIO_SUPPORT=y
CONFIG_SPL_LIBCOMMON_SUPPORT=y
CONFIG_SPL_LIBGENERIC_SUPPORT=y
CONFIG_SYS_MALLOC_F_LEN=0x10000
CONFIG_DM_GPIO=y
CONFIG_SPL_MMC_SUPPORT=y
CONFIG_SPL_SERIAL_SUPPORT=y
CONFIG_SPL_DRIVERS_MISC_SUPPORT=y
CONFIG_NR_DRAM_BANKS=2
CONFIG_SYS_MMCSD_RAW_MODE_U_BOOT_PARTITION_TYPE=0xdf
CONFIG_SPL=y
CONFIG_DEBUG_UART_BASE=0x3C05D000
CONFIG_DEBUG_UART_CLOCK=100000000
CONFIG_SPL_LIBDISK_SUPPORT=y
CONFIG_SPL_SPI_FLASH_SUPPORT=y
CONFIG_SPL_SPI_SUPPORT=y
CONFIG_PPC470S=y
CONFIG_TARGET_1888TX018=y
CONFIG_DEBUG_UART=y
CONFIG_TOOLS_DEBUG=y
CONFIG_PHYS_64BIT=y
CONFIG_USE_BOOTARGS=y
CONFIG_BOOTARGS="console=ttyAMA0 root=/dev/mmcblk0p2 rootwait"
CONFIG_USE_BOOTCOMMAND=y
CONFIG_BOOTCOMMAND="run kernelsd"
CONFIG_LOGLEVEL=8
CONFIG_SPL_BOARD_INIT=y
# CONFIG_SPL_RAW_IMAGE_SUPPORT is not set
CONFIG_SPL_SEPARATE_BSS=y
CONFIG_SYS_MMCSD_RAW_MODE_U_BOOT_USE_PARTITION=y
CONFIG_SYS_MMCSD_RAW_MODE_U_BOOT_USE_PARTITION_TYPE=y
CONFIG_SPL_I2C_SUPPORT=y
CONFIG_SPL_MTD_SUPPORT=y
CONFIG_SPL_NAND_SUPPORT=y
CONFIG_SPL_POST_MEM_SUPPORT=y
CONFIG_CMD_MEMINFO=y
CONFIG_CMD_MEMTEST=y
CONFIG_CMD_MEMMAP=y
CONFIG_CMD_GPIO=y
CONFIG_CMD_MMC=y
CONFIG_CMD_NAND=y
CONFIG_CMD_PART=y
CONFIG_CMD_USB_MASS_STORAGE=y
CONFIG_CMD_DHCP=y
CONFIG_CMD_PING=y
CONFIG_CMD_EXT4=y
CONFIG_CMD_FAT=y
CONFIG_CMD_FS_GENERIC=y
CONFIG_CMD_MTDPARTS=y
CONFIG_MTDIDS_DEFAULT="mtd0"
CONFIG_CMD_RCM_SRAM_NOR_TEST=y
CONFIG_OF_CONTROL=y
CONFIG_SPL_OF_CONTROL=y
CONFIG_DEFAULT_DEVICE_TREE="malina"
CONFIG_ENV_IS_IN_MMC=y
CONFIG_NET_RANDOM_ETHADDR=y
CONFIG_DM=y
CONFIG_SPL_DM=y
CONFIG_SPL_DM_SEQ_ALIAS=y
CONFIG_REGMAP=y
CONFIG_SPL_REGMAP=y
CONFIG_CLK=y
CONFIG_SPL_CLK=y
CONFIG_TX018_LSIF_CLOCK=y
CONFIG_1888TX018_DDR=y
CONFIG_1888TX018_DDR_EM0_SIZE=2048
CONFIG_1888TX018_DDR_EM1_SIZE=2048
CONFIG_PL061_GPIO=y
CONFIG_DM_I2C=y
CONFIG_SYS_I2C_OCORES=y
# CONFIG_INPUT is not set
CONFIG_MISC=y
CONFIG_I2C_EEPROM=y
CONFIG_SPL_I2C_EEPROM=y
CONFIG_DM_MMC=y
CONFIG_MMC_RCM=y
CONFIG_MTD=y
CONFIG_DM_MTD=y
CONFIG_MTD_NOR_FLASH=y
CONFIG_MTD_RCM_NOR=y
CONFIG_MTD_RAW_NAND=y
CONFIG_MTD_RCM_NAND=y
CONFIG_DM_SPI_FLASH=y
CONFIG_SPI_FLASH_STMICRO=y
CONFIG_MTD_UBI=y
CONFIG_DM_ETH=y
CONFIG_GRETH_ETH=y
# CONFIG_PCI is not set
CONFIG_PINCTRL=y
CONFIG_SPL_PINCTRL=y
CONFIG_PINCTRL_PL061=y
CONFIG_BAUDRATE=1000000
CONFIG_DM_SERIAL=y
CONFIG_DEBUG_UART_PL011=y
CONFIG_SPI=y
CONFIG_DM_SPI=y
CONFIG_PL022_SPI=y
CONFIG_USB=y
CONFIG_DM_USB=y
CONFIG_USB_MUSB_GADGET=y
CONFIG_USB_MUSB_RCM=y
CONFIG_USB_GADGET=y
CONFIG_USB_GADGET_MANUFACTURER="RC Module"
CONFIG_USB_GADGET_VENDOR_NUM=0x0005
CONFIG_USB_GADGET_PRODUCT_NUM=0x0002
CONFIG_USB_GADGET_DOWNLOAD=y
```

## drivers/ddr/rcm/1888tx018/Kconfig
```kconfig
config 1888TX018_DDR
	bool "1888tx018 DDR SDRAM driver"
	depends on TARGET_1888TX018
	help
	  Enable DDR SDRAM controller for the 1888tx018 device.

config 1888TX018_DDR_SPD
	depends on 1888TX018_DDR
	bool "Initialize DDR timings from SPD"
	help
	  Use SPD to configure timings and size.

config 1888TX018_DDR_EM0_SIZE
	depends on !1888TX018_DDR_SPD
	int "EM0 DDR Size (MiB)"
	default 1024

config 1888TX018_DDR_EM1_SIZE
	depends on !1888TX018_DDR_SPD
	int "EM1 DDR Size (MiB)"
	default 1024


choice 1888TX018_DDR_SPEED
    prompt "DDR3 Speed Selection"
	depends on !1888TX018_DDR_SPD

	config 1888TX018_DDR_1600
	bool "DDR3 1600"

	config 1888TX018_DDR_1333
	bool "DDR3 1333"

	config 1888TX018_DDR_1060
	bool "DDR3 1060"

	config 1888TX018_DDR_800
	bool "DDR3 800"

endchoice
```
